## drivers/net/wireless/realtek/rtl8188eus/Kconfig
```kconfig
config RTL8188EU
	tristate "Realtek 8188EUS/8188ETV USB WiFi (rtl8188eus)"
	depends on USB && CFG80211
	help
	  Out-of-tree aircrack-ng/rtl8188eus driver for Realtek RTL8188EUS /
	  RTL8188ETV USB adapters (USB ID 0bda:8179 and clones, e.g. many
	  cheap "802.11n" dongles and TP-Link TL-WN725N v2). Supports monitor
	  mode and packet injection, which the in-tree staging r8188eu driver
	  does not. Build it BUILT-IN (=y): with Samsung RKP enabled, loading
	  it as a module at runtime resets the device.
```

## drivers/net/wireless/realtek/rtl8812au/Kconfig
```kconfig
config 88XXAU
	tristate "Realtek 8812AU/8811AU/8821AU/8814AU USB WiFi (rtl88xxau)"
	depends on USB && CFG80211
	help
	  Out-of-tree aircrack-ng/rtl8812au driver (v5.6.4.2) for Realtek
	  RTL8811AU/8812AU/8821AU/8814AU USB adapters (e.g. TP-Link Archer
	  T2U V3, Alfa AWUS036ACH). Supports monitor mode and injection.
```

## drivers/video/fbdev/exynos/dpu30/Kconfig
```kconfig
config EXYNOS_DPU30
	bool "Samsung Exynos Display Sub-system (DPP, DECON, MIPI, DISPLAYPORT)"
	select EXYNOS_IOMMU
	select MEDIA_CAMERA_SUPPORT
	select PHY_EXYNOS_MIPI_DSIM
	default n
	depends on FB

if EXYNOS_DPU30
config EXYNOS_DPP
	bool "Samsung Exynos Display Post Processor driver"
	depends on EXYNOS_DPU30
	default y

config EXYNOS_MIPI_DSIM
	bool "Samsung Exynos MIPI-DSI driver"
	depends on EXYNOS_DPU30
	default y
	help
	  Enable MIPI-DSI driver.

config EXYNOS_DISPLAYPORT
	bool "Samsung Exynos DISPLAYPORT driver"
	depends on EXYNOS_DPU30
	default n
	help
	  Enable DISPLAYPORT driver.

config EXYNOS_WINDOW_UPDATE
        bool "Support Window Update Mode"
        depends on EXYNOS_DPU30
        default n

config EXYNOS_BLOCK_MODE
	bool "Support Blocking Mode"
        depends on EXYNOS_DPU30
        default y

config EXYNOS_HIBERNATION
	bool "Support Display Hibernation Mode"
        depends on EXYNOS_DPU30
        default n

config EXYNOS_CHANGE_HIBER_CNT
	bool "Change Hibernation Entry Count at Runtime"
        depends on EXYNOS_DPU30 && EXYNOS_HIBERNATION
        default n

config EXYNOS_HIBERNATION_EARLY_WAKEUP
	bool "Support Hibernation Early Wakeup (EXPERIMENTAL)"
        depends on EXYNOS_DPU30 && EXYNOS_HIBERNATION
        default n

config EXYNOS_DOZE
	bool "Support DOZE mode"
        depends on EXYNOS_DPU30
        default n

config EXYNOS_DOZE_HIBERNATION
	bool "Support Display Hibernation Mode"
       depends on EXYNOS_DOZE && EXYNOS_HIBERNATION
       default n

config EXYNOS_AFBC_DEBUG
	bool "Support AFBC Decoder Debug"
        depends on EXYNOS_DPU30
        default n

config EXYNOS_MULTIRESOLUTION
	bool "Support Multi Resolution LCD"
	depends on EXYNOS_DPU30 && EXYNOS_WINDOW_UPDATE
	default n

config EXYNOS_VIRTUAL_DISPLAY
	bool "Support Virtual Display Mode"
	depends on EXYNOS_DPU30
	default n
	help
	  If this menu is enabled, you can boot up board without LCD.

config EXYNOS_READ_ESD_SOLUTION
	bool "Support ESD solution using read DDI power state"
	depends on EXYNOS_DPU30
	default n
	help
	  If this menu is enabled, you can detect ESD of panel.

config EXYNOS_READ_ESD_SOLUTION_TEST
	bool "Support ESD solution using read DDI power state"
	depends on EXYNOS_READ_ESD_SOLUTION
	default n
	help
	  If this menu is enabled, you can test ESD recovery.

config EXYNOS_LOW_PERSISTENCE
	bool "Support Low Persistence Mode"
        depends on EXYNOS_DPU30
	default n

config EXYNOS_CURSOR
	bool "Support Cursor Async Mode"
        depends on EXYNOS_DPU30
	default n

config EXYNOS_DSIM_DITHER
	bool "DSIM SSCG feature"
        depends on EXYNOS_MIPI_DSIM
        default n

config DECON_BTS_LEGACY
	bool "Legacy BTS scheme of display"
        depends on EXYNOS_DPU30
        default n

config FB_TEST
	bool "Framebuffer test only"
        depends on EXYNOS_DPU30
        default n

config DSIM_CMD_TEST
	bool "DSIM command test only"
        depends on EXYNOS_DPU30
        default n

config EXYNOS_FREQ_HOP
	bool "Support DPHY PLL Frequency Hopping"
        depends on EXYNOS_DPU30
        default n

config EXYNOS_PLL_SLEEP
	bool "Support DPHY PLL Sleep"
        depends on EXYNOS_DPU30
        default n

config EXYNOS_EWR
	bool "Support early wake up"
        depends on EXYNOS_DPU30
        default n

config EXYNOS_LIMIT_ROTATION
	bool "Limit Rotation based on Size and Bit-depth"
        depends on EXYNOS_DPU30
        default n

config EXYNOS_HDR_TUNE
	bool "Support HDR Tuning"
        depends on EXYNOS_DPU30
        default n

config EXYNOS_DPU30_FBCON
	bool "Support plain fbdev/fbcon clients (non-Android userspace)"
	depends on EXYNOS_DPU30 && !EXYNOS_HIBERNATION
	select FB_CFB_FILLRECT
	select FB_CFB_COPYAREA
	select FB_CFB_IMAGEBLIT
	default n
	help
	  Make /dev/fb0 usable without Android's HWC, e.g. for fbcon or
	  a GNU/Linux userspace booted from the recovery partition.
	  The framebuffer stays mapped in the kernel, decon0 is unblanked
	  at boot and a new frame is started on every vsync so CPU writes
	  to the framebuffer reach command-mode panels.

	  Ported from map220v's Galaxy A51 (dpu20) Linux patches.
	  Say N for Android builds.

endif

config EXYNOS_DECON_DQE
	bool "Samsung Exynos DQE driver"
	depends on EXYNOS_DPU30
	default n

config NO_LCD
	bool "support NO_LCD"
	depends on EXYNOS_DPU30
	default n

source "drivers/video/fbdev/exynos/dpu30/panels/Kconfig"
```
